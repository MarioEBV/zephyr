## boards/nxp/frdm_rw612_is25lp256/Kconfig.frdm_rw612_is25lp256
```kconfig
# Copyright 2024 NXP
# SPDX-License-Identifier: Apache-2.0

config BOARD_FRDM_RW612_IS25LP256
	select SOC_PART_NUMBER_RW612ETA2I
```

## boards/nxp/frdm_rw612_is25lp256/board.yml
```yaml
board:
  name: frdm_rw612_is25lp256
  full_name: FRDM_RW612_IS25LP256
  vendor: nxp
  socs:
    - name: rw612
```
