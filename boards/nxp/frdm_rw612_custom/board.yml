## boards/nxp/frdm_rw612_custom/board.yml
```yaml
board:
  name: frdm_rw612_custom
  full_name: FRDM_RW612_CUSTOM
  vendor: nxp
  socs:
    - name: rw612
```

## boards/nxp/frdm_rw612_mt25/board.yml
```yaml
board:
  name: frdm_rw612_mt25
  full_name: FRDM_RW612_MT25
  vendor: nxp
  socs:
    - name: rw612
```
